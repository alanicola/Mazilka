
#include "Constants.h"
#include "IOpins.h"


int volts;                                          // напряжение батареи
int pause=-1;                                       // значение -1 означает, что напряжение батареи нормально, 
                                                    //0 и 1 используются для мигания светодиодом на пине 13, когда батарея разряжена
byte pen;
byte turn;

int lspeed;                                        // скорость левого двигателя     -255 to +255 (отрицательное значение - вращение в обратную сторону)
int rspeed;                                        // скорость правого двигателя    -255 to +255 (отрицательное значение - вращение в обратную сторону)
int dspeed=80;                                     // скорость рисования            +50 to +200

volatile int rcount;                                // счетчик на правом колесе (8 полный оборот)
volatile int lcount;                                // счетчик на левом колесе  (8 полный оборот)

void setup()

{

  attachInterrupt(0,Rcount,CHANGE);                 // разрешаем прерывание на 2м пине (счетчик оборотов правое колесо)
  attachInterrupt(1,Lcount,CHANGE);                 // разрешаем прерывание на 3м пине (счетчик оборотов левое колесо)
  
  digitalWrite(2,1);                                // подтягиваем резистор на 2м пине
  digitalWrite(3,1);                                // подтягиваем резистор на 3м пине

  Serial.begin(57600);                              // настройка серийного порта для связи на скорости 57600  

  pinMode(Ldirpin,OUTPUT);                          // пин левого двигателя настраиваем на выход
  pinMode(Rdirpin,OUTPUT);                          // пин правого двигателя настраиваем на выход
  pinMode(Srvopin,OUTPUT);                          // пин серво мотора настраиваем на выход

  Up();                                             // во время старта программы фломастер/ручка должен не касаться поверхности для рисования

  delay(500);                                       // небольшая задержка
  
}

void loop()
{ 
                                                    // проверяем необходимые условия для начала рисования
  volts=analogRead(Battery)/20;                     // считываем значение АЦП 
  
  if(volts<lowbat || pause!=-1)                     // сравниваем полученной значение с минимальным ИЛИ флагом паузы
  {
    lspeed=0;                                       // установить скорость левого мотора
    rspeed=0;                                       // установить скорость праваго мотора
    Motors();                                       // задать скорости моторам
    if (pause<0) Up();                              // моргаем светодиодом 
    pause++;                                         
    if(pause>1) pause=0;                             
    digitalWrite(13,pause);                          
    delay(200);                                      
    return;                                         // заново проверяем условия для запуска рисования
  }
                                                    // current is proportional to voltage and power = voltage x current
                                                    // As the battery voltage drops dspeed increases to maintain a constant speed
                                                    //ток пропорционален напряжению и мощности = произведение напряжения и тока
                                                    //При падении напряжения батареи увеличивается скорость для поддержания постоянной скорости
  
  dspeed=26214/volts*10/volts;                      // скорость при полной батарее (ориг. draw speed power correction factor=100% when battery=5V (analog reading = 1023))
  dspeed=dspeed*8/10;                               // отрегулированная скорость (ориг. adjust speed to reduce overshoot)

  Serial.println("run");                            // команда для программы трассировки движений робота

  rA();                                             // команда для рисования  русской буквы А (файл Alfavit.ino)
  rB();                                             // команда для рисования  русской буквы Б (файл Alfavit.ino)
  END();                                            // после окончания рисования ничего не делать до сброса питания или нажатия кнопки reset
  
}


  





